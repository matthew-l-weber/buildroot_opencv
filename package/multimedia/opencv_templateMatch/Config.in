## package/multimedia/opencv_templateMatch/Config.in
```kconfig
config BR2_PACKAGE_OPENCV_TEMPLATEMATCH
	bool "opencv_templatematch"
	help
	  Test utility to analize runtime of template matching algorithm.
```
